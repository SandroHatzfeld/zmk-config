## config/boards/shields/narfbloq/Kconfig.defconfig
```kconfig
# Copyright (c) 2020 The ZMK Contributors
# SPDX-License-Identifier: MIT

if SHIELD_NARFBLOQ

config ZMK_KEYBOARD_NAME
    default "narfbloq"

config ZMK_SLEEP
    default y

config ZMK_IDLE_SLEEP_TIMEOUT
    default 900000

endif
```
